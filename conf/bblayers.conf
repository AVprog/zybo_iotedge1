## conf/bblayers.conf
```bitbake
LCONF_VERSION = "7"

BBPATH = "${TOPDIR}"
BBFILES ?= ""

BBLAYERS ?= " \
    /home/sav44/work/yocto19/sources/core/meta \
    /home/sav44/work/yocto19/sources/core/meta-poky \
    /home/sav44/work/yocto19/sources/core/../meta-openembedded/meta-perl \
    /home/sav44/work/yocto19/sources/core/../meta-openembedded/meta-python \
    /home/sav44/work/yocto19/sources/core/../meta-openembedded/meta-filesystems \
    /home/sav44/work/yocto19/sources/core/../meta-openembedded/meta-gnome \
    /home/sav44/work/yocto19/sources/core/../meta-openembedded/meta-multimedia \
    /home/sav44/work/yocto19/sources/core/../meta-openembedded/meta-networking \
    /home/sav44/work/yocto19/sources/core/../meta-openembedded/meta-webserver \
    /home/sav44/work/yocto19/sources/core/../meta-openembedded/meta-xfce \
    /home/sav44/work/yocto19/sources/core/../meta-openembedded/meta-initramfs \
    /home/sav44/work/yocto19/sources/core/../meta-openembedded/meta-oe \
    /home/sav44/work/yocto19/sources/core/../meta-browser \
    /home/sav44/work/yocto19/sources/core/../meta-qt5 \
    /home/sav44/work/yocto19/sources/core/../meta-xilinx/meta-xilinx-bsp \
    /home/sav44/work/yocto19/sources/core/../meta-xilinx/meta-xilinx-contrib \
    /home/sav44/work/yocto19/sources/core/../meta-xilinx-tools \
    /home/sav44/work/yocto19/sources/core/../meta-petalinux \
    /home/sav44/work/yocto19/sources/core/../meta-virtualization \
    /home/sav44/work/yocto19/sources/core/../meta-openamp \
    /home/sav44/work/yocto19/sources/meta-user \
    /home/sav44/work/yocto19/sources/meta-iotedge \
    /home/sav44/work/yocto19/sources/meta-rust \
"

BBLAYERS_NON_REMOVABLE ?= " \
    /home/sav44/work/yocto19/sources/core/meta \
"
```

## meta-user/recipes-my1timer/my1timer/files/Kconfig
```kconfig
#
# Configuration for CONFIG_MY1_TIMER
#

config MY1_TIMER
	tristate "MY1TIMER very good"
	default m
	help
	  my first timer driver AAAAAAAAAAAAA
```
